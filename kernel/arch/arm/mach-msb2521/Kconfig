## kernel/arch/arm/mach-msb2521/Kconfig
```kconfig
# SPDX-License-Identifier: GPL-2.0-only
config ARCH_MSB2521
	bool "MStar MSB2521 (GoClever Navio 505)"
	depends on ARCH_MULTI_V5
	select CPU_ARM926T
	select CLKSRC_MMIO
	help
	  Support for the GoClever Navio 505 PND (MStar MSB2521 U03,
	  ARM926EJ-S). Relies on DRAM, clocks and the LCD scanout set up by
	  the vendor EBOOT. Provides IRQ controller, timers, UART0 console,
	  simple-framebuffer LCD and the Power key. No NAND or SD driver.
```

## kernel/navio505_defconfig
```kconfig
CONFIG_LOCALVERSION="-navio505-1.0"
CONFIG_MMU=y
CONFIG_ARM_PATCH_PHYS_VIRT=y
CONFIG_PHYS_OFFSET=0x20400000
# CONFIG_AUTO_ZRELADDR is not set
# CONFIG_LOCALVERSION_AUTO is not set
CONFIG_SYSVIPC=y
CONFIG_PRINTK=y
CONFIG_LOG_BUF_SHIFT=17
CONFIG_BLK_DEV_INITRD=y
CONFIG_INITRAMFS_SOURCE=""
CONFIG_RD_GZIP=y
CONFIG_EXPERT=y
CONFIG_EMBEDDED=y
# CONFIG_ARCH_MULTI_V7 is not set
CONFIG_ARCH_MULTI_V5=y
CONFIG_ARCH_MSB2521=y
CONFIG_AEABI=y
# CONFIG_OABI_COMPAT is not set
# CONFIG_CPU_SW_DOMAIN_PAN is not set
CONFIG_VMSPLIT_3G=y
CONFIG_HZ_100=y
CONFIG_PREEMPT_NONE=y
# CONFIG_HIGH_RES_TIMERS is not set
CONFIG_HZ_PERIODIC=y
# setitimer()/alarm() for userspace; musl implements alarm() via setitimer.
CONFIG_POSIX_TIMERS=y
# CONFIG_SMP is not set
# CONFIG_CPU_IDLE is not set
# CONFIG_SUSPEND is not set
CONFIG_BINFMT_ELF=y
# CONFIG_COREDUMP is not set
# CONFIG_MODULES is not set
# CONFIG_BLOCK is not set
# CONFIG_NET is not set
CONFIG_VT=y
CONFIG_CONSOLE_TRANSLATIONS=y
CONFIG_VT_CONSOLE=y
CONFIG_UNIX98_PTYS=y
# CONFIG_LEGACY_PTYS is not set
CONFIG_TTY=y
CONFIG_SERIAL_8250=y
CONFIG_SERIAL_8250_CONSOLE=y
CONFIG_SERIAL_8250_NR_UARTS=1
CONFIG_SERIAL_8250_RUNTIME_UARTS=1
CONFIG_SERIAL_OF_PLATFORM=y
CONFIG_SERIAL_EARLYCON=y
# CONFIG_SERIAL_8250_PNP is not set
# CONFIG_HW_RANDOM is not set
# CONFIG_I2C is not set
# CONFIG_SPI is not set
# CONFIG_MTD is not set
# CONFIG_MMC is not set
# CONFIG_USB_SUPPORT is not set
# CONFIG_DRM is not set
CONFIG_FB=y
CONFIG_FB_DEVICE=y
CONFIG_FB_SIMPLE=y
CONFIG_FRAMEBUFFER_CONSOLE=y
# CONFIG_FRAMEBUFFER_CONSOLE_DEFERRED_TAKEOVER is not set
# CONFIG_LOGO is not set
CONFIG_FONTS=y
CONFIG_FONT_8x16=y
# CONFIG_SOUND is not set
# CONFIG_RTC_CLASS is not set
# CONFIG_WATCHDOG is not set
CONFIG_PROC_FS=y
CONFIG_SYSFS=y
CONFIG_TMPFS=y
CONFIG_DEVTMPFS=y
# CONFIG_DEBUG_MISC is not set
# CONFIG_FTRACE is not set
# CONFIG_PERF_EVENTS is not set
CONFIG_FRAME_POINTER=y
CONFIG_DEBUG_INFO_NONE=y
CONFIG_DEBUG_KERNEL=y
CONFIG_DEBUG_LL=y
CONFIG_DEBUG_LL_UART_8250=y
CONFIG_DEBUG_UART_PHYS=0xa0007600
CONFIG_DEBUG_UART_VIRT=0xf0007600
CONFIG_DEBUG_UART_8250_SHIFT=3
# CONFIG_DEBUG_UART_8250_WORD is not set
CONFIG_EARLY_PRINTK=y

CONFIG_COMPAT_32BIT_TIME=y

CONFIG_BINFMT_SCRIPT=y
CONFIG_MULTIUSER=y
```
